## components/control/Kconfig
```kconfig
menu "SVC-100 Control"

config SVC_USE_LOGIC_ENGINE
    bool "Use the IF/FOR/THEN logic engine for relay control (review-gated)"
    default n
    help
        When enabled, control.c drives relays via the components/logic engine
        (presence/digital-input conditions with FOR dwell, OFF-delay linger, and
        OFF interlocks) and applies the SVC-012 dry-contact presence fallback.

        DEFAULT OFF. The legacy per-rule evaluator remains the production path
        until this integration is signed off on the bench. Do NOT enable for a
        production build without Codex review and bench validation.

endmenu
```

## components/svc_hal/Kconfig
```kconfig
menu "Smart Villa OS — Hardware Target"

choice SVC_TARGET
    prompt "Hardware target board"
    default SVC_TARGET_SVC100_REVA
    help
        Selects the HAL target compiled and registered at boot. Exactly one.

        NOTE: the default stays SVC-100 Rev A until app_main/services are wired
        through hal_install()/hal_board_init() (SVC-024/SVC-025). Today app_main
        still boots the SVC-100 board path directly, so defaulting to a KinCony
        target would stamp the config board_id as KinCony while actually running
        SVC-100 hardware — a dangerous mismatch for the OTA/config board guard.
        Do NOT make a KinCony target the default until the HAL wiring lands.

    config SVC_TARGET_SVC100_REVA
        bool "SVC-100 Pro Rev A (ESP32-S3, native GPIO) — default until HAL wired"
    config SVC_TARGET_KINCONY_A8
        bool "KinCony KC868-A8 (ESP32, PCF8574 IO)"
    config SVC_TARGET_KINCONY_A16
        bool "KinCony KC868-A16 (ESP32, PCF8574 IO)"
endchoice

config SVC_BOARD_ID
    string "Expected board_id (config-target guard)"
    default "kincony_kc868_a8" if SVC_TARGET_KINCONY_A8
    default "kincony_kc868_a16" if SVC_TARGET_KINCONY_A16
    default "svc100_reva" if SVC_TARGET_SVC100_REVA
    help
        Stored configs tagged with a different board_id are rejected and
        factory-defaulted on load (prevents cross-board config/firmware mixups).

endmenu
```

## sdkconfig.defaults
```kconfig
# SVC OS — COMMON build defaults (target-neutral). Applied to EVERY target.
# Per-silicon overrides live in sdkconfig.defaults.<idf_target> and are auto-
# merged by idf.py AFTER this file. Local sdkconfig is git-ignored.

# --- Default target (overridden by `idf.py set-target <t>` e.g. in CI) ---
CONFIG_IDF_TARGET="esp32s3"

# --- Partition table (16 MB dual-OTA; a per-target file may override the name) ---
CONFIG_PARTITION_TABLE_CUSTOM=y
CONFIG_PARTITION_TABLE_CUSTOM_FILENAME="partitions.csv"

# --- App / OTA rollback ---
CONFIG_BOOTLOADER_APP_ROLLBACK_ENABLE=y
CONFIG_BOOTLOADER_APP_ANTI_ROLLBACK=n

# --- FreeRTOS / Watchdog ---
CONFIG_FREERTOS_HZ=1000
CONFIG_ESP_TASK_WDT_INIT=y
CONFIG_ESP_TASK_WDT_PANIC=y
CONFIG_ESP_TASK_WDT_TIMEOUT_S=10
CONFIG_ESP_INT_WDT=y

# --- Networking / services (optional layer) ---
CONFIG_HTTPD_MAX_REQ_HDR_LEN=1024
CONFIG_ESP_HTTPS_OTA_ALLOW_HTTP=n
CONFIG_MBEDTLS_DYNAMIC_BUFFER=y

# --- Logging ---
CONFIG_LOG_DEFAULT_LEVEL_INFO=y
CONFIG_LOG_MAXIMUM_LEVEL_DEBUG=y

# --- Compiler ---
CONFIG_COMPILER_OPTIMIZATION_PERF=y
CONFIG_COMPILER_WARN_WRITE_STRINGS=y
```

## sdkconfig.defaults.esp32
```kconfig
# KinCony KC868-A8 — classic ESP32-WROOM-32 (4 MB flash, NO PSRAM).
# Merged AFTER sdkconfig.defaults when the target is esp32.
#
# PREPARED FOR SVC-026 PHASE 2 — NOT BUILT IN CI YET. Before enabling the esp32
# leg of the build matrix:
#   1. Wire app_main/services through hal_install()/hal_board_init() (SVC-024/025).
#      Today app_main still boots the SVC-100 board path, which uses ESP32-S3-only
#      pins and USB-Serial-JTAG and will NOT link for classic ESP32.
#   2. Provide a 4 MB partition table and enable the override below — the shared
#      partitions.csv is a 16 MB dual-3 MB-OTA layout that does NOT fit 4 MB.

# --- Board / HAL profile (pins board_id = kincony_kc868_a8 for the config guard) ---
CONFIG_SVC_TARGET_KINCONY_A8=y

# --- Flash: 4 MB, DIO @ 40 MHz ---
CONFIG_ESPTOOLPY_FLASHSIZE_4MB=y
CONFIG_ESPTOOLPY_FLASHMODE_DIO=y
CONFIG_ESPTOOLPY_FLASHFREQ_40M=y

# --- No PSRAM on KC868-A8 ---
CONFIG_SPIRAM=n

# --- Console over UART0 (classic ESP32 has no USB-Serial-JTAG) ---
CONFIG_ESP_CONSOLE_UART_DEFAULT=y

# --- 4 MB partition table (create partitions_kincony.csv, then enable) ---
# CONFIG_PARTITION_TABLE_CUSTOM_FILENAME="partitions_kincony.csv"
```

## sdkconfig.defaults.esp32s3
```kconfig
# SVC-100 Rev A — ESP32-S3-WROOM-1-N16R8 (16 MB flash, 8 MB octal PSRAM).
# Merged AFTER sdkconfig.defaults when the target is esp32s3.

# --- Board / HAL profile (pins board_id = svc100_reva for the config guard) ---
CONFIG_SVC_TARGET_SVC100_REVA=y

# --- Flash: 16 MB, QIO @ 80 MHz ---
CONFIG_ESPTOOLPY_FLASHSIZE_16MB=y
CONFIG_ESPTOOLPY_FLASHMODE_QIO=y
CONFIG_ESPTOOLPY_FLASHFREQ_80M=y

# --- Octal PSRAM ---
CONFIG_SPIRAM=y
CONFIG_SPIRAM_MODE_OCT=y
CONFIG_SPIRAM_SPEED_80M=y

# --- Console over USB-C (native USB-Serial-JTAG) ---
CONFIG_ESP_CONSOLE_USB_SERIAL_JTAG=y
```
